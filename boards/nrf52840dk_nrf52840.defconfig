## boards/nrf52840dk_nrf52840.defconfig
```kconfig
CONFIG_BT=y
CONFIG_BT_DEBUG_LOG=y
CONFIG_BT_SMP=y
CONFIG_BT_PERIPHERAL=y
CONFIG_BT_DIS=y
CONFIG_BT_DIS_PNP=n
CONFIG_BT_DEVICE_NAME="BLEP1"
CONFIG_BT_DEVICE_APPEARANCE=1367

CONFIG_SERIAL=y
CONFIG_UART_INTERRUPT_DRIVEN=y

CONFIG_NRFX_UARTE1=y
CONFIG_NFCT_PINS_AS_GPIOS=y

CONFIG_POSIX_API=y
CONFIG_PICOLIBC=y
CONFIG_FPU=y
```

## firmware/tests/testcase.yaml
```yaml
tests:
  # section.subsection
  openp1.tests:
    build_only: false
    platform_allow: native_posix_64
    integration_platforms:
      - native_posix_64
    tags: testing
```
